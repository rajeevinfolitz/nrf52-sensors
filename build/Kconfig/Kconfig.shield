## build/Kconfig/Kconfig.shield
```kconfig
osource "c:/nordic/myapps/adc/boards/shields/*/Kconfig.shield"
osource "C:/ncs/v2.4.2/nrf/boards/shields/*/Kconfig.shield"
```

## build/Kconfig/Kconfig.shield.defconfig
```kconfig
osource "c:/nordic/myapps/adc/boards/shields/*/Kconfig.defconfig"
osource "C:/ncs/v2.4.2/nrf/boards/shields/*/Kconfig.defconfig"
```
